## main/Kconfig.projbuild
```kconfig
menu "Saber Bridge"

    config BRIDGE_FAKE_SABER
        bool "Variante fake saber (emulatore della NXT, niente host USB)"
        default n
        help
            Al posto della spada vera c'è un piccolo emulatore della NXT dietro gli stessi buffer.
            La console resta sulla USB della XIAO (USB-Serial-JTAG): si compila con
            sdkconfig.fake in aggiunta a sdkconfig.defaults (vedi tools/build-all.sh).

    config BRIDGE_BLE_NAME
        string "Nome BLE (scan response, al massimo 29 caratteri)"
        default "SaberBridge"

    config BRIDGE_SABER_ANY_DEVICE
        bool "Accetta qualsiasi dispositivo CDC"
        depends on !BRIDGE_FAKE_SABER
        default n
        help
            Se disattivato, il bridge apre solo le spade note:
            0483:5740 (Anima NXT) e 16C0:0483 (Anima EVO).

    config BRIDGE_CDC_INTERFACE
        int "Indice dell'interfaccia CDC della spada"
        depends on !BRIDGE_FAKE_SABER
        range 0 15
        default 0

    config BRIDGE_ASSERT_DTR
        bool "Asserisci DTR all'apertura"
        depends on !BRIDGE_FAKE_SABER
        default y

    config BRIDGE_ASSERT_RTS
        bool "Asserisci RTS all'apertura"
        depends on !BRIDGE_FAKE_SABER
        default y
        help
            pyserial apre la porta con DTR e RTS asseriti: il bridge fa lo stesso.
            Le due opzioni servono per provarli separatamente.

    config BRIDGE_LED_GPIO
        int "GPIO del LED di stato (-1 = nessun LED)"
        range -1 48
        default 21

    config BRIDGE_LED_ACTIVE_LOW
        bool "LED attivo basso"
        depends on BRIDGE_LED_GPIO >= 0
        default y

    config BRIDGE_BATTERY
        bool "Lettura della batteria"
        default n
        help
            Richiede un partitore dalla batteria a un GPIO di ADC1 (per esempio due resistenze
            da 220 kOhm) con un condensatore da 100 nF verso massa sul punto centrale: il
            partitore ad alta impedenza da solo non basta al campionamento dell'ADC.

    config BRIDGE_BATTERY_GPIO
        int "GPIO del partitore (ADC1: GPIO1-GPIO10)"
        depends on BRIDGE_BATTERY
        range 1 10
        default 1

    config BRIDGE_BATTERY_DIVIDER_X1000
        int "Rapporto del partitore Vbat/Vpin, x1000"
        depends on BRIDGE_BATTERY
        range 1000 10000
        default 2000
        help
            2000 per due resistenze uguali.

    config BRIDGE_BATTERY_LOW_MV
        int "Soglia di batteria bassa (mV)"
        depends on BRIDGE_BATTERY
        range 3000 4200
        default 3400

    choice BRIDGE_LOG_LEVEL_CHOICE
        prompt "Livello di log del bridge"
        default BRIDGE_LOG_LEVEL_INFO
        help
            Vale per i moduli del bridge, non per ESP-IDF.
            Debug e Verbose sono visibili anche se il livello massimo di ESP-IDF è più basso.

        config BRIDGE_LOG_LEVEL_ERROR
            bool "Error"
        config BRIDGE_LOG_LEVEL_WARN
            bool "Warning"
        config BRIDGE_LOG_LEVEL_INFO
            bool "Info"
        config BRIDGE_LOG_LEVEL_DEBUG
            bool "Debug"
        config BRIDGE_LOG_LEVEL_VERBOSE
            bool "Verbose"
    endchoice

    config BRIDGE_LOG_LEVEL
        int
        default 1 if BRIDGE_LOG_LEVEL_ERROR
        default 2 if BRIDGE_LOG_LEVEL_WARN
        default 3 if BRIDGE_LOG_LEVEL_INFO
        default 4 if BRIDGE_LOG_LEVEL_DEBUG
        default 5 if BRIDGE_LOG_LEVEL_VERBOSE

endmenu
```
